## CMakeLists.txt
```
# SPDX-License-Identifier: Apache-2.0

cmake_minimum_required(VERSION 3.20.0)

find_package(Zephyr REQUIRED HINTS $ENV{ZEPHYR_BASE})
project(hello_world)

FILE(GLOB_RECURSE app_sources src/*.c src/*.cpp)

target_sources(app PRIVATE 
    ${app_sources}
)
```

## sample.yaml
```
sample:
  description: nRF52840 code to control swarm of Sphero Bolts
  name: Sphero Swarmalators
common:
  tags: introduction
  integration_platforms:
    - native_posix
  harness: console
  harness_config:
    type: one_line
    regex:
      - "Hello World! (.*)"
tests:
  sample.basic.helloworld:
    tags: introduction
```

## prj.conf
```kconfig
CONFIG_CPP=y
CONFIG_STD_CPP17=y 
CONFIG_CPP_MAIN=y
CONFIG_GLIBCXX_LIBCPP=y
CONFIG_NEWLIB_LIBC=y
CONFIG_NEWLIB_LIBC_NANO=n
CONFIG_CPP_EXCEPTIONS=y
# # Enable the BLE stack with GATT Client configuration
CONFIG_BT=y
CONFIG_BT_CENTRAL=y
CONFIG_BT_GATT_CLIENT=y
CONFIG_BT_SMP=y
CONFIG_BT_MAX_CONN=15
CONFIG_BT_CONN_CTX=y

# Enable BLE modules
CONFIG_BT_SCAN=y
CONFIG_BT_SCAN_FILTER_ENABLE=y
CONFIG_BT_GATT_DM=y
CONFIG_HEAP_MEM_POOL_SIZE=2048
CONFIG_BT_SCAN_NAME_CNT=15
CONFIG_BT_RX_STACK_SIZE=2048
CONFIG_BT_HCI_TX_STACK_SIZE=1536

# Logging
CONFIG_LOG=y
CONFIG_LOG_BUFFER_SIZE=4096
CONFIG_LOG_BACKEND_UART=n
CONFIG_LOG_BACKEND_RTT=y
CONFIG_RTT_CONSOLE=y
CONFIG_UART_CONSOLE=n
CONFIG_USE_SEGGER_RTT=y

# CONFIG_THREAD_ANALYZER=y
# CONFIG_THREAD_ANALYZER_USE_LOG=y
# CONFIG_THREAD_ANALYZER_AUTO=y
# CONFIG_THREAD_ANALYZER_AUTO_INTERVAL=5

# Handle faults better
CONFIG_THREAD_NAME=y
CONFIG_RESET_ON_FATAL_ERROR=n
CONFIG_INIT_STACKS=y
CONFIG_THREAD_STACK_INFO=y

# Increase main stack size
CONFIG_MAIN_STACK_SIZE=4096
CONFIG_SYSTEM_WORKQUEUE_STACK_SIZE=4096

CONFIG_SYSTEM_WORKQUEUE_STACK_SIZE=4096

# Multithreading
CONFIG_MULTITHREADING=y

# Pooling
CONFIG_POLL=y

# Serial communication
CONFIG_SERIAL=y
CONFIG_UART_ASYNC_API=y

CONFIG_LOG_PRINTK=n

CONFIG_TIMING_FUNCTIONS=y
```

## src/main.c
```c
// Kernal
#include <zephyr/kernel.h>
// Bluetooth
#include <bluetooth/conn_ctx.h>
#include <bluetooth/gatt_dm.h>
#include <bluetooth/scan.h>
#include <zephyr/bluetooth/bluetooth.h>
#include <zephyr/bluetooth/conn.h>
#include <zephyr/bluetooth/gatt.h>
// Logging
#include <zephyr/debug/thread_analyzer.h>
#include <zephyr/logging/log.h>
// Clients
#include "ble/sphero_client.h"

LOG_MODULE_REGISTER(main, LOG_LEVEL_DBG);

static struct bt_conn* default_conn;

BT_CONN_CTX_DEF(conns, CONFIG_BT_MAX_CONN, sizeof(struct bt_sphero_client));

static void exchange_func(struct bt_conn* conn, uint8_t err, struct bt_gatt_exchange_params* params)
{
    if (!err) {
        LOG_INF("exchange func: MTU exchange done");
    } else {
        LOG_WRN("exchange func: MTU exchange failed (err %d)", err);
    }
}

static void on_sent(struct bt_conn* conn, uint8_t err,
    struct bt_gatt_write_params* params)
{
    LOG_DBG("Sent had error code: %d", err);
}

static void discovery_complete(struct bt_gatt_dm* dm, void* context)
{
    LOG_INF("Discovery complete");

    struct bt_sphero_client* sphero = context;

    bt_sphero_handles_assign(dm, sphero);

    bt_gatt_dm_data_release(dm);

    int err = bt_scan_start(BT_SCAN_TYPE_SCAN_ACTIVE);

    if (err) {
        LOG_ERR("Scanning failed to start (err %d)", err);
    } else {
        LOG_INF("Scanning started");
    }

    // Send wake up message

    unsigned char data[] = { 0x8d, 0xa, 0x13, 0xd, 0x0, 0xd5, 0xd8 };

    LOG_INF("Sending command");

    bt_sphero_client_send(sphero, data, sizeof(data));
}

static void discovery_service_not_found(struct bt_conn* conn,
    void* context)
{
    LOG_INF("Service not found");

    int err = bt_scan_start(BT_SCAN_TYPE_SCAN_ACTIVE);
    if (err) {
        LOG_ERR("Scanning failed to start (err %d)", err);
    } else {
        LOG_INF("Scanning started");
    }
}

static void discovery_error(struct bt_conn* conn,
    int err,
    void* context)
{
    LOG_WRN("Error while discovering GATT database: (%d)", err);
}

struct bt_gatt_dm_cb discovery_cb = {
    .completed = discovery_complete,
    .service_not_found = discovery_service_not_found,
    .error_found = discovery_error,
};

static void gatt_discover(struct bt_conn* conn)
{
    int err;

    struct bt_sphero_client* sphero_client = bt_conn_ctx_get(&conns_ctx_lib, conn);

    if (!sphero_client) {
        return;
    }

    err = bt_gatt_dm_start(conn, BT_SPHERO_SERVICE_UUID, &discovery_cb, sphero_client);

    if (err) {
        LOG_ERR("Could not start the discovery procedure, error: %d", err);
    }

    bt_conn_ctx_release(&conns_ctx_lib, (void*)sphero_client);
}

static void connected(struct bt_conn* conn, uint8_t conn_err)
{
    char addr[BT_ADDR_LE_STR_LEN];
    int err;

    struct bt_sphero_client_init_param init = {};

    bt_addr_le_to_str(bt_conn_get_dst(conn), addr, sizeof(addr));

    if (conn_err) {
        LOG_INF("Failed to connect to %s (%d)", addr, conn_err);

        if (default_conn == conn) {
            bt_conn_unref(default_conn);
            default_conn = NULL;

            err = bt_scan_start(BT_SCAN_TYPE_SCAN_ACTIVE);
            if (err) {
                LOG_ERR("Scanning failed to start (err %d)", err);
            }
        }

        return;
    }

    LOG_INF("Connected: %s", addr);

    // Allocate memory for this connection using the connection context library

    struct bt_sphero_client* sphero_client = bt_conn_ctx_alloc(&conns_ctx_lib, conn);

    if (!sphero_client) {
        LOG_WRN("There is no free memory to allocate the connection context");
    }

    memset(sphero_client, 0, bt_conn_ctx_block_size_get(&conns_ctx_lib));

    err = bt_sphero_client_init(sphero_client, &init);

    bt_conn_ctx_release(&conns_ctx_lib, (void*)sphero_client);

    if (err) {
        LOG_ERR("Sphero client initalization failed (err %d)", err);
    } else {
        LOG_INF("Sphero Clinet module initalized");
    }

    gatt_discover(conn);

    // Stop scanning during discovery

    err = bt_scan_stop();
    if ((!err) && (err != -EALREADY)) {
        LOG_ERR("Stop LE scan failed (err %d)", err);
    }
}

static void disconnected(struct bt_conn* conn, uint8_t reason)
{
    char addr[BT_ADDR_LE_STR_LEN];
    int err;

    bt_addr_le_to_str(bt_conn_get_dst(conn), addr, sizeof(addr));

    LOG_INF("Disconnected: %s (reason %u)", addr,
        reason);

    err = bt_conn_ctx_free(&conns_ctx_lib, conn);

    if (err) {
        LOG_WRN("The connection context could not be freed (err %d)", err);
    }

    bt_conn_unref(conn);
    default_conn = NULL;
}

static void security_changed(struct bt_conn* conn, bt_security_t level,
    enum bt_security_err err)
{
    char addr[BT_ADDR_LE_STR_LEN];

    bt_addr_le_to_str(bt_conn_get_dst(conn), addr, sizeof(addr));

    if (!err) {
        LOG_INF("Security changed: %s level %u", addr, level);
    } else {
        LOG_WRN("Security failed: %s level %u err %d", addr,
            level, err);
    }

    gatt_discover(conn);
}

BT_CONN_CB_DEFINE(conn_callbacks) = {
    .connected = connected,
    .disconnected = disconnected,
    .security_changed = security_changed,
};

static void scan_filter_match(struct bt_scan_device_info* device_info, struct bt_scan_filter_match* filter_match, bool connectable)
{
    char addr[BT_ADDR_LE_STR_LEN];

    bt_addr_le_to_str(device_info->recv_info->addr, addr, sizeof(addr));

    LOG_INF("Filters matched. Address: %s connectable: %d",
        addr, connectable);
}

static void scan_connecting_error(struct bt_scan_device_info* device_info)
{
    LOG_ERR("Connecting failed");
}

#define NAME_LEN 30

static bool data_cb(struct bt_data* data, void* user_data)
{
    uint8_t len;
    char* name = user_data;

    switch (data->type) {
    case BT_DATA_NAME_SHORTENED:
    case BT_DATA_NAME_COMPLETE:
        len = MIN(data->data_len, NAME_LEN - 1);
        memcpy(name, data->data, len);
        name[len] = '\0';
        return false;
    default:
        return true;
    }
}

static void scan_connecting(struct bt_scan_device_info* device_info, struct bt_conn* conn)
{
    char name[NAME_LEN];

    (void)memset(name, 0, sizeof(name));

    bt_data_parse(device_info->adv_data, data_cb, name);

    LOG_DBG("Connecting to %s", name);

    default_conn = bt_conn_ref(conn);
}

BT_SCAN_CB_INIT(scan_cb, scan_filter_match, NULL, scan_connecting_error, scan_connecting);

static int scan_init(void)
{
    int err;
    struct bt_scan_init_param scan_init = {
        .connect_if_match = 1,
        .scan_param = BT_LE_SCAN_PARAM(BT_LE_SCAN_TYPE_ACTIVE, BT_LE_SCAN_OPT_NONE,
            BT_GAP_SCAN_FAST_INTERVAL, BT_GAP_SCAN_FAST_WINDOW),
    };

    bt_scan_init(&scan_init);
    bt_scan_cb_register(&scan_cb);

    int sphero_names_len = 15;

    char* sphero_names[] = {
        "SB-1B35",
        "SB-F860",
        "SB-2175",
        "SB-3026",
        "SB-618E",
        "SB-6B58",
        "SB-9938",
        "SB-BFD4",
        "SB-C1D2",
        "SB-CEFA",
        "SB-DF1D",
        "SB-F465",
        "SB-F479",
        "SB-F885",
        "SB-FCB2"
    };

    for (int i = 0; i < sphero_names_len; i++) {
        err = bt_scan_filter_add(BT_SCAN_FILTER_TYPE_NAME, sphero_names[i]);
        if (err) {
            LOG_ERR("Scanning filters cannot be set (err %d)", err);
            return err;
        }
    }

    err = bt_scan_filter_enable(BT_SCAN_NAME_FILTER, false);
    if (err) {
        LOG_ERR("Filters cannot be turned on (err %d)", err);
        return err;
    }

    LOG_INF("Scan module initialized");
    return err;
}

static void auth_cancel(struct bt_conn* conn)
{
    char addr[BT_ADDR_LE_STR_LEN];

    bt_addr_le_to_str(bt_conn_get_dst(conn), addr, sizeof(addr));

    LOG_INF("Pairing cancelled: %s", addr);
}

static void pairing_complete(struct bt_conn* conn, bool bonded)
{
    char addr[BT_ADDR_LE_STR_LEN];

    bt_addr_le_to_str(bt_conn_get_dst(conn), addr, sizeof(addr));

    LOG_INF("Pairing complete: %s, bonded: %d", addr, bonded);
}

static void pairing_failed(struct bt_conn* conn, enum bt_security_err reason)
{
    char addr[BT_ADDR_LE_STR_LEN];

    bt_addr_le_to_str(bt_conn_get_dst(conn), addr, sizeof(addr));

    LOG_INF("Pairing failed conn: %s, reason %d", addr, reason);
}

static struct bt_conn_auth_cb conn_auth_callbacks = {
    .cancel = auth_cancel,
};

static struct bt_conn_auth_info_cb conn_auth_info_callbacks = {
    .pairing_complete = pairing_complete,
    .pairing_failed = pairing_failed,
};

int main()
{
    int err;

    err = bt_conn_auth_cb_register(&conn_auth_callbacks);
    if (err) {
        LOG_ERR("Failed to register authorization callback (err %d)", err);
        return 0;
    }

    err = bt_conn_auth_info_cb_register(&conn_auth_info_callbacks);
    if (err) {
        LOG_ERR("Failed to register authorization info callback (err %d)", err);
        return 0;
    }

    err = bt_enable(NULL);
    if (err) {
        LOG_ERR("Bluetooth init failed (err %d)", err);
        return 0;
    }

    LOG_INF("Bluetooth initialized");

    err = scan_init();
    if (err != 0) {
        LOG_ERR("Scan module failed to initialize (err %d)", err);
        return 0;
    }

    err = bt_scan_start(BT_SCAN_TYPE_SCAN_ACTIVE);
    if (err) {
        LOG_ERR("Scanning failed to start (err %d)", err);
        return 0;
    }

    LOG_INF("Scanning successfully started");

    return 1;
}
```

## src/main.cpp
```c
#include "nrf_sphero/sphero.hpp"
#include "nrf_sphero/sphero_scanner.hpp"
#include <zephyr/drivers/uart.h>
#include <zephyr/kernel.h>
// Logging
#include <cstdlib>
#include <zephyr/logging/log.h>
#include <zephyr/timing/timing.h>

LOG_MODULE_REGISTER(main, LOG_LEVEL_DBG);

// UART variables

#define RECIEVE_BUFF_SIZE 93
#define UART_RX_TIMEOUT 100
#define UART_WAIT_FOR_BUF_DELAY K_MSEC(50)

static struct k_work_delayable uart_work;

const struct device* uart = DEVICE_DT_GET(DT_NODELABEL(uart0));

struct uart_data_t {
    void* fifo_reserved;
    uint8_t data[RECIEVE_BUFF_SIZE];
    uint16_t len;
};

static K_FIFO_DEFINE(fifo_uart_rx_data);
static K_FIFO_DEFINE(fifo_uart_tx_data);

// DEFINE STATE MACHINE

enum class States {
    IDLE = 0,
    MATCH = 1,
    SET_COLORS = 2,
};

States state = States::IDLE;
uint8_t matching = 0;

static void uart_cb(const struct device* dev, struct uart_event* evt, void* user_data)
{
    ARG_UNUSED(dev);

    static size_t aborted_len;
    struct uart_data_t* buf;
    static uint8_t* aborted_buf;
    static bool disable_req;

    switch (evt->type) {
    case UART_TX_DONE:
        if ((evt->data.tx.len == 0) || (!evt->data.tx.buf)) {
            return;
        }

        if (aborted_buf) {
            buf = CONTAINER_OF(aborted_buf, struct uart_data_t,
                data);
            aborted_buf = NULL;
            aborted_len = 0;
        } else {
            buf = CONTAINER_OF(evt->data.tx.buf,
                struct uart_data_t,
                data);
        }

        k_free(buf);

        buf = (uart_data_t*)k_fifo_get(&fifo_uart_tx_data, K_NO_WAIT);
        if (!buf) {
            return;
        }

        if (uart_tx(uart, buf->data, buf->len, SYS_FOREVER_MS)) {
            LOG_WRN("Failed to send data over UART");
        }

        break;

    case UART_RX_RDY:
        buf = CONTAINER_OF(evt->data.rx.buf, struct uart_data_t, data);
        buf->len += evt->data.rx.len;

        if (disable_req) {
            return;
        }

        if ((evt->data.rx.buf[buf->len - 1] == '\n')) {
            disable_req = true;
            uart_rx_disable(uart);
        }

        break;

    case UART_RX_DISABLED:
        disable_req = false;

        buf = (uart_data_t*)k_malloc(sizeof(*buf));
        if (buf) {
            buf->len = 0;
        } else {
            LOG_WRN("Not able to allocate UART receive buffer");
            k_work_reschedule(&uart_work, UART_WAIT_FOR_BUF_DELAY);
            return;
        }

        uart_rx_enable(uart, buf->data, sizeof(buf->data),
            UART_RX_TIMEOUT);

        break;

    case UART_RX_BUF_REQUEST:
        buf = (uart_data_t*)k_malloc(sizeof(*buf));
        if (buf) {
            buf->len = 0;
            uart_rx_buf_rsp(uart, buf->data, sizeof(buf->data));
        } else {
            LOG_WRN("Not able to allocate UART receive buffer");
        }

        break;

    case UART_RX_BUF_RELEASED:
        buf = CONTAINER_OF(evt->data.rx_buf.buf, struct uart_data_t,
            data);

        if (buf->len > 0) {
            LOG_DBG("Adding %d bytes to fifo", buf->len);
            k_fifo_put(&fifo_uart_rx_data, buf);
        } else {
            k_free(buf);
        }

        break;

    case UART_TX_ABORTED:
        if (!aborted_buf) {
            aborted_buf = (uint8_t*)evt->data.tx.buf;
        }

        aborted_len += evt->data.tx.len;
        buf = CONTAINER_OF(aborted_buf, struct uart_data_t,
            data);

        uart_tx(uart, &buf->data[aborted_len],
            buf->len - aborted_len, SYS_FOREVER_MS);

        break;

    default:
        break;
    }
}

static void uart_work_handler(struct k_work* item)
{
    struct uart_data_t* buf;

    buf = (uart_data_t*)k_malloc(sizeof(*buf));

    if (buf) {
        buf->len = 0;
    } else {
        LOG_WRN("Not able to allocate UART receive buffer (uart_work_handler)");
        k_work_reschedule(&uart_work, UART_WAIT_FOR_BUF_DELAY);
        return;
    }

    uart_rx_enable(uart, buf->data, sizeof(buf->data), UART_RX_TIMEOUT);
}

const struct uart_config uart_cfg = {
    .baudrate = 115200,
    .parity = UART_CFG_PARITY_NONE,
    .stop_bits = UART_CFG_STOP_BITS_1,
    .data_bits = UART_CFG_DATA_BITS_8,
    .flow_ctrl = UART_CFG_FLOW_CTRL_RTS_CTS
};

static int uart_init(void)
{
    int err;

    struct uart_data_t* rx;

    if (!device_is_ready(uart)) {
        return -ENODEV;
    }

    err = uart_configure(uart, &uart_cfg);

    if (err) {
        LOG_ERR("Cannot configure UART (err: %d)", err);
        return err;
    }

    // SETUP UART RX

    rx = (struct uart_data_t*)k_malloc(sizeof(*rx));
    if (rx) {
        rx->len = 0;
    } else {
        return -ENOMEM;
    }

    k_work_init_delayable(&uart_work, uart_work_handler);

    err = uart_callback_set(uart, uart_cb, NULL);
    if (err) {
        LOG_ERR("Cannot initalize UART callback");
        return err;
    }

    err = uart_rx_enable(uart, rx->data, sizeof(rx->data), UART_RX_TIMEOUT);
    if (err) {
        LOG_ERR("Cannot enable RX (err: %d)", err);
        k_free(rx);
    }

    return err;
}

bool validate_uart_packet(uart_data_t* rx)
{
    // Check for starting byte
    if (rx->data[0] != 0x8d) {
        LOG_ERR("Recieved invalid starting byte: 0x%02x", rx->data[0]);
        return false;
    }

    // Check for ending byte
    if (rx->data[rx->len - 1] != 0x0a) {
        LOG_ERR("Recieved invalid ending byte: 0x%02x", rx->data[rx->len - 1]);
        return false;
    }

    return true;
}

// Function to convert a uint8_t to States enum, with error handling
States uint8ToState(uint8_t value)
{
    if (value >= static_cast<uint8_t>(States::IDLE) && value <= static_cast<uint8_t>(States::SET_COLORS)) {
        return static_cast<States>(value);
    } else {
        return States::IDLE;
    }
}

void handle_idle_state(uart_data_t* rx)
{
    if (rx->len != 4) {
        LOG_ERR("Recieved %d bytes, expected 4", rx->len);
        return;
    }

    if (rx->data[1] != 0x01) {
        LOG_ERR("Recieved invalid command byte: 0x%02x", rx->data[1]);
        return;
    }

    state = uint8ToState(rx->data[2]);

    LOG_DBG("State is now %d", static_cast<uint8_t>(state));
}

uint8_t matching_index = 0;

std::vector<std::vector<uint8_t>> frame = {
    { 0, 0, 0, 0, 0, 0, 0, 1 },
    { 0, 0, 0, 0, 0, 0, 0, 1 },
    { 0, 0, 0, 0, 0, 0, 0, 1 },
    { 0, 0, 0, 0, 0, 0, 0, 1 },
    { 0, 0, 0, 0, 0, 0, 0, 1 },
    { 0, 0, 0, 0, 0, 0, 0, 1 },
    { 0, 0, 0, 0, 0, 0, 0, 1 },
    { 0, 0, 0, 0, 0, 0, 0, 1 },
};

std::vector<RGBColor> palette = { RGBColor(0, 0, 0), RGBColor(255, 255, 255) };

void handle_match_state(uart_data_t* rx, std::vector<std::shared_ptr<Sphero>>* spheros)
{
    if (matching >= spheros->size()) {
        LOG_ERR("Matching is greater than number of spheros");
        return;
    }

    if (rx->len < 3) {
        LOG_ERR("Recieved %d bytes, expected at least 3", rx->len);
        return;
    }

    LOG_DBG("Match command is: 0x%02x", rx->data[1]);

    auto sphero = (*spheros)[matching_index];

    switch (rx->data[1]) {
    case 0x01: // Increment matching index
        LOG_DBG("incrementing matching index");
        matching_index++;

        sphero->set_all_leds_with_map({ { Sphero::LEDs::FRONT_BLUE, 0 }, { Sphero::LEDs::BACK_BLUE, 0 } });

        break;
    case 0x02: // Switch to orientation (front-light)
        LOG_DBG("Switching to front-light orientation");

        // Reset the sphero aim
        sphero->reset_aim();

        sphero->set_all_leds_with_map({ { Sphero::LEDs::FRONT_BLUE, 255 } });

        break;
    case 0x03: // Turn on back-light for orientation
        LOG_DBG("Switching to back-light orientation");

        sphero->set_all_leds_with_map({ { Sphero::LEDs::FRONT_BLUE, 0 }, { Sphero::LEDs::BACK_BLUE, 255 } });

        break;
    case 0x04: // Handle changing heading and resetting aim
        LOG_DBG("Correcting heading");

        uint16_t heading = (rx->data[2] << 8) | (rx->data[3]); // big-endian format
        LOG_DBG("Angle is: %d", heading);
        auto response = sphero->drive_with_response(0, heading);

        sphero->wait_for_response(response);
        k_msleep(600);

        sphero->reset_aim();
        LOG_DBG("Resetted aim!");
        break;
    }
}

void handle_color_state(uart_data_t* rx, std::vector<std::shared_ptr<Sphero>>* spheros)
{
    // data[0] is always 0x8d
    // data[1] is command byte
    // Then we have 3 * spheros for colors
    // Then we have 3 * spheros for velocities
    // Then we have the end byte

    if (rx->len != 3 + (6 * spheros->size())) {
        LOG_ERR("Recieved %d bytes, expected %d", rx->len, 3 + (6 * spheros->size()));
        return;
    }

    if (rx->data[1] != 0x01) {
        LOG_ERR("Recieved invalid command byte: 0x%02x", rx->data[1]);
        return;
    }

    // Set the state colors
    for (int i = 0; i < spheros->size(); i++) {
        auto color = RGBColor(rx->data[(i * 3) + 2], rx->data[(i * 3 + 1) + 2], rx->data[(i * 3 + 2) + 2]);
        (*spheros)[i]->set_matrix_color(color);
    }

    int offset = 2 + (3 * spheros->size());

    // Set the velocities
    for (int i = 0; i < spheros->size(); i++) {
        uint8_t speed = rx->data[offset + (i * 3)];
        uint16_t heading = (rx->data[offset + (i * 3) + 1] << 8) | (rx->data[offset + (i * 3) + 2]); // big-endian format
        LOG_DBG("Speed is: %d, heading is: %d", speed, heading);
        (*spheros)[i]->drive(speed, heading);
    }
}

void reset(std::vector<std::shared_ptr<Sphero>>* spheros)
{
    LOG_DBG("Resetting state!");

    // Clear the LED matrix on all spheros
    for (auto sphero : *spheros) {
        sphero->clear_matrix();
        sphero->set_matrix_color(RGBColor(0, 0, 0));
        sphero->set_all_leds_with_map({ { Sphero::LEDs::FRONT_BLUE, 0 }, { Sphero::LEDs::BACK_BLUE, 0 } });
    }

    matching_index = 0;
    state = States::IDLE;
}

void send_response(uint8_t* data, size_t data_size)
{
    struct uart_data_t* tx = (struct uart_data_t*)k_malloc(sizeof(*tx));

    tx->len = data_size + 2;

    tx->data[0] = 0x8d;
    memcpy(&tx->data[1], data, sizeof(data));
    tx->data[tx->len - 1] = 0x0a;

    int err = uart_tx(uart, tx->data, tx->len, SYS_FOREVER_MS);
    if (err) {
        LOG_ERR("Error when sending data to UART (err %d)", err);
        k_fifo_put(&fifo_uart_tx_data, tx);
    }
}

// Function to convert a range of uint8_t array to std::string
std::string uint8ToString(const uint8_t* data, size_t start, size_t end)
{
    return std::string(reinterpret_cast<const char*>(data + start), end - start);
}

int main(void)
{
    int err;

    // Init UART

    err = uart_init();

    if (err) {
        LOG_ERR("Failed to initialize UART (err %d)", err);
        return 1;
    }

    // Get the names of the Spheros to connect to

    LOG_DBG("nrfSphero started. Waiting for Sphero Names...");

    std::vector<std::string> names;

    for (;;) {
        struct uart_data_t* rx = (struct uart_data_t*)k_fifo_get(&fifo_uart_rx_data, K_FOREVER);

        if (!validate_uart_packet(rx)) {
            k_free(rx);
            continue;
        }

        if (rx->len == 3 && rx->data[1] == 0x00) {
            // Client asking for reset, ask for Sphero names
            k_free(rx);
            uint8_t data[] = { 0x01 };
            size_t data_size = sizeof(data) / sizeof(data[0]);
            send_response(data, data_size);
            continue;
        }

        if (rx->len == 4 && rx->data[1] == 0x01) {
            // Finished adding Spheros
            k_free(rx);
            uint8_t data[] = { 0x05 };
            size_t data_size = sizeof(data) / sizeof(data[0]);
            send_response(data, data_size);
            break;
        }

        // Define the range of indices you want to push
        size_t start_index = 1; // Skip start of packet
        size_t end_index = rx->len - 1; // Skip end of packet

        std::string sphero_name = uint8ToString(rx->data, start_index, end_index);

        names.push_back(sphero_name);

        k_free(rx);

        // Send response

        uint8_t data[] = { 0xFF };
        size_t data_size = sizeof(data) / sizeof(data[0]);
        send_response(data, data_size);
    }

    // SETUP SPHEROS

    SpheroScanner scanner(names);

    err = scanner.start_scanning();

    if (err) {
        LOG_ERR("Failed to start scanning (err %d)", err);
        return 0;
    } else {
        LOG_INF("Scanning started");
    }

    while (!scanner.found_all_spheros()) {
        k_msleep(5);
    }

    scanner.stop_scanning();

    LOG_DBG("Found all spheros");

    auto spheros = scanner.get_spheros();
    LOG_INF("Found %d spheros", scanner.get_num_spheros());

    // Ready to start, tell python
    uint8_t data[] = { 0x10 };
    size_t data_size = sizeof(data) / sizeof(data[0]);
    send_response(data, data_size);

    // MAIN LOOP
    for (;;) {
        struct uart_data_t* rx = (struct uart_data_t*)k_fifo_get(&fifo_uart_rx_data, K_FOREVER);

        if (rx) {
            if (!validate_uart_packet(rx)) {
                k_free(rx);
                continue;
            }

            if (rx->data[1] == 0x00) {
                reset(&spheros);
            } else {
                switch (state) {
                case States::IDLE:
                    handle_idle_state(rx);

                    if (state == States::SET_COLORS) {
                        for (auto sphero : spheros) {
                            sphero->set_matrix_color(RGBColor(255, 255, 255));
                        }
                    }

                    break;
                case States::MATCH:
                    handle_match_state(rx, &spheros);
                    break;
                case States::SET_COLORS:
                    handle_color_state(rx, &spheros);
                    break;
                }
            }

            LOG_DBG("Freeing rx!");

            k_free(rx);

            // Send response

            LOG_DBG("Sending response!");

            uint8_t data[] = { 0xFF };
            size_t data_size = sizeof(data) / sizeof(data[0]);
            send_response(data, data_size);

            LOG_DBG("Sent response!");
        }
    }

    return 0;
}
```
